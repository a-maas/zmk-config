## config/boards/shields/MountainBreeze/Kconfig.defconfig
```kconfig
if SHIELD_MOUNTAIN_BREEZE_LEFT

config ZMK_KEYBOARD_NAME
	default "Mountain Breeze"

config ZMK_SPLIT_BLE_ROLE_CENTRAL
	default y

endif

if SHIELD_MOUNTAIN_BREEZE_LEFT || SHIELD_MOUNTAIN_BREEZE_RIGHT

config ZMK_SPLIT
	default y

config ZMK_DISPLAY
	default y
 
endif
```

## config/boards/shields/MountainBreeze/Kconfig.shield
```kconfig
# Copyright (c) 2022 The ZMK Contributors
# SPDX-License-Identifier: MIT

config SHIELD_MOUNTAIN_BREEZE_LEFT
    def_bool $(shields_list_contains,mountain_breeze_left)

config SHIELD_MOUNTAIN_BREEZE_RIGHT
    def_bool $(shields_list_contains,mountain_breeze_right)
```
