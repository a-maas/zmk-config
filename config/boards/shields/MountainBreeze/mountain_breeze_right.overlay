/*
 * Copyright (c) 2022 The ZMK Contributors
 *
 * SPDX-License-Identifier: MIT
 */

#include "mountain_breeze.dtsi"

&default_transform {
	row-offset = <5>;
};

&kscan0 {
		row-gpios
			= <&pro_micro 21  (GPIO_ACTIVE_HIGH | GPIO_PULL_DOWN)>
			, <&pro_micro 20  (GPIO_ACTIVE_HIGH | GPIO_PULL_DOWN)>
			, <&pro_micro 19  (GPIO_ACTIVE_HIGH | GPIO_PULL_DOWN)>
			, <&pro_micro 18  (GPIO_ACTIVE_HIGH | GPIO_PULL_DOWN)>
			, <&pro_micro 15 (GPIO_ACTIVE_HIGH | GPIO_PULL_DOWN)>
			;
};

// Enable the SPI that will be used for the nice view display
&nice_view_spi {
    status = "okay";
    cs-gpios = <&pro_micro 10 GPIO_ACTIVE_HIGH>;
};